/*
 * Generated by MTK SP DrvGen Version: 3.5.160809 for MT6877.
 * 2023-12-12 19:24:07
 * Do Not Modify The File.
 * Copyright Mediatek Inc. (c) 2016.
*/

&gpio_usage_mapping {
	GPIO_FDD_BAND_SUPPORT_DETECT_1ST_PIN = <&pio 71 0>;
	GPIO_FDD_BAND_SUPPORT_DETECT_2ND_PIN = <&pio 72 0>;
	GPIO_FDD_BAND_SUPPORT_DETECT_3RD_PIN = <&pio 73 0>;
	GPIO_FDD_BAND_SUPPORT_DETECT_4TH_PIN = <&pio 74 0>;
	GPIO_RF_PWREN_RST_PIN = <&pio 75 0>;
	GPIO_SIM2_SIO = <&pio 170 0>;
	GPIO_SIM2_SCLK = <&pio 171 0>;
	GPIO_SIM2_SRST = <&pio 172 0>;
	GPIO_SIM1_SRST = <&pio 173 0>;
	GPIO_SIM1_SCLK = <&pio 174 0>;
	GPIO_SIM1_SIO = <&pio 175 0>;
	GPIO_SIM1_HOT_PLUG = <&pio 176 0>;
	GPIO_SIM2_HOT_PLUG = <&pio 177 0>;
};
